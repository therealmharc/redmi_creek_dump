/dts-v1/;

/ {
	model = "Qualcomm Technologies, Inc. KHAJE IDP nopmi";
	compatible = "qcom,khaje-idp", "qcom,khaje", "qcom,idp";
	qcom,msm-id = <0x24a 0x10000>;
	qcom,board-id = <0x10022 0x00>;
	qcom,pmic-id = <0x2d 0x00 0x00 0x00>;

	fragment@0 {
		target = <0xffffffff>;

		__overlay__ {

			pm6125-tz {

				cooling-maps {

					trip0_cpu0 {
						trip = <0xffffffff>;
						cooling-device = <0xffffffff 0x07 0x07>;
					};

					trip0_cpu1 {
						trip = <0xffffffff>;
						cooling-device = <0xffffffff 0x07 0x07>;
					};

					trip0_cpu2 {
						trip = <0xffffffff>;
						cooling-device = <0xffffffff 0x07 0x07>;
					};

					trip0_cpu3 {
						trip = <0xffffffff>;
						cooling-device = <0xffffffff 0x07 0x07>;
					};

					trip0_cpu4 {
						trip = <0xffffffff>;
						cooling-device = <0xffffffff 0x06 0xffffffff>;
					};

					trip0_cpu5 {
						trip = <0xffffffff>;
						cooling-device = <0xffffffff 0x06 0xffffffff>;
					};

					trip0_cpu6 {
						trip = <0xffffffff>;
						cooling-device = <0xffffffff 0x06 0xffffffff>;
					};

					trip0_cpu7 {
						trip = <0xffffffff>;
						cooling-device = <0xffffffff 0x06 0xffffffff>;
					};

					trip1_cpu1 {
						trip = <0xffffffff>;
						cooling-device = <0xffffffff 0x01 0x01>;
					};

					trip1_cpu2 {
						trip = <0xffffffff>;
						cooling-device = <0xffffffff 0x01 0x01>;
					};

					trip1_cpu3 {
						trip = <0xffffffff>;
						cooling-device = <0xffffffff 0x01 0x01>;
					};

					trip1_cpu4 {
						trip = <0xffffffff>;
						cooling-device = <0xffffffff 0x01 0x01>;
					};

					trip1_cpu5 {
						trip = <0xffffffff>;
						cooling-device = <0xffffffff 0x01 0x01>;
					};

					trip1_cpu6 {
						trip = <0xffffffff>;
						cooling-device = <0xffffffff 0x01 0x01>;
					};

					trip1_cpu7 {
						trip = <0xffffffff>;
						cooling-device = <0xffffffff 0x01 0x01>;
					};
				};
			};
		};
	};

	fragment@1 {
		target = <0xffffffff>;

		__overlay__ {
			status = "ok";
		};
	};

	fragment@2 {
		target = <0xffffffff>;

		__overlay__ {
			pinctrl-0 = <0xffffffff 0xffffffff 0x01>;

			rf_pa1_therm {
				reg = <0x55>;
				label = "rf_pa1_therm";
				qcom,ratiometric;
				qcom,hw-settle-time = <0xc8>;
				qcom,pre-scaling = <0x01 0x01>;
			};
		};
	};

	fragment@3 {
		target = <0xffffffff>;

		__overlay__ {
			status = "ok";

			rf_pa1_therm {
				reg = <0x03>;
				io-channels = <0xffffffff 0x55>;
				qcom,ratiometric;
				qcom,hw-settle-time-us = <0xc8>;
			};
		};
	};

	fragment@4 {
		target = <0xffffffff>;

		__overlay__ {

			rf-pa1-therm-usr {
				polling-delay-passive = <0x00>;
				polling-delay = <0x00>;
				thermal-governor = "user_space";
				thermal-sensors = <0xffffffff 0x03>;
				wake-capable-sensor;

				trips {

					active-config0 {
						temperature = <0x1e848>;
						hysteresis = <0x3e8>;
						type = "passive";
					};
				};
			};
		};
	};

	fragment@5 {
		target = <0xffffffff>;

		__overlay__ {

			rf_pa1_therm {

				rf_pa1_therm_default {
					pins = "gpio7";
					bias-high-impedance;
					phandle = <0x01>;
				};
			};

			vib_out_gpio8 {

				vib_out_gpio8_default {
					pins = "gpio8";
					function = "normal";
					bias-pull-up;
					power-source = <0x00>;
					phandle = <0x03>;
				};
			};

			key_vol_up {

				key_vol_up_default {
					pins = "gpio5";
					function = "normal";
					input-enable;
					bias-pull-up;
					power-source = <0x00>;
					phandle = <0x02>;
				};
			};

			eldo9_pin {

				gpio@c000 {
					pins = "gpio1";
					function = "normal";
					qcom,drive-strength = <0x02>;
					power-source = <0x00>;
					bias-disable;
					output-high;
					phandle = <0x04>;
				};
			};
		};
	};

	fragment@6 {
		target = <0xffffffff>;

		__overlay__ {

			gpio_keys {
				compatible = "gpio-keys";
				label = "gpio-keys";
				pinctrl-names = "default";
				pinctrl-0 = <0x02>;

				vol_up {
					label = "volume_up";
					gpios = <0xffffffff 0x05 0x01>;
					linux,input-type = <0x01>;
					linux,code = <0x73>;
					linux,can-disable;
					debounce-interval = <0x0f>;
					gpio-key,wakeup;
				};
			};

			vibrator_gpio {
				status = "ok";
				compatible = "qcom,qpnp-vibrator-ldo";
				pinctrl-names = "default";
				pinctrl-0 = <0x03>;
				vib,en-gpio = <0xffffffff 0x08 0x01>;
			};

			vdda_usb_ss_dp_core {
				compatible = "regulator-fixed";
				regulator-name = "vdd_supply";
				regulator-min-microvolt = <0xd6d80>;
				regulator-max-microvolt = <0xd6d80>;
				enable-active-high;
				gpio = <0xffffffff 0x01 0x00>;
				pinctrl-names = "default";
				pinctrl-0 = <0x04>;
				phandle = <0x05>;
			};
		};
	};

	fragment@7 {
		target = <0xffffffff>;

		__overlay__ {
			vdd-supply = <0x05>;
		};
	};

	fragment@8 {
		target = <0xffffffff>;

		__overlay__ {

			awinic@64 {
				compatible = "awinic,aw2016_led";
				reg = <0x64>;

				awinic,red {
					awinic,name = "red";
					awinic,id = <0x00>;
					awinic,imax = <0x02>;
					awinic,led-current = <0x03>;
					awinic,max-brightness = <0xff>;
					awinic,rise-time-ms = <0x06>;
					awinic,hold-time-ms = <0x00>;
					awinic,fall-time-ms = <0x06>;
					awinic,off-time-ms = <0x04>;
				};

				awinic,green {
					awinic,name = "green";
					awinic,id = <0x01>;
					awinic,imax = <0x02>;
					awinic,led-current = <0x03>;
					awinic,max-brightness = <0xff>;
					awinic,rise-time-ms = <0x06>;
					awinic,hold-time-ms = <0x00>;
					awinic,fall-time-ms = <0x06>;
					awinic,off-time-ms = <0x04>;
				};

				awinic,blue {
					awinic,name = "blue";
					awinic,id = <0x02>;
					awinic,imax = <0x02>;
					awinic,led-current = <0x03>;
					awinic,max-brightness = <0xff>;
					awinic,rise-time-ms = <0x06>;
					awinic,hold-time-ms = <0x00>;
					awinic,fall-time-ms = <0x06>;
					awinic,off-time-ms = <0x04>;
				};
			};
		};
	};

	fragment@9 {
		target = <0xffffffff>;

		__overlay__ {
			vdd-supply = <0xffffffff>;
			qcom,vdd-voltage-level = <0x2d2a80 0x2d2a80>;
			qcom,vdd-current-level = <0x00 0x8b290>;
			vdd-io-supply = <0xffffffff>;
			qcom,vdd-io-always-on;
			qcom,vdd-io-lpm-sup;
			qcom,vdd-io-voltage-level = <0x1b7740 0x1b7740>;
			qcom,vdd-io-current-level = <0x00 0x4f588>;
			pinctrl-names = "default", "sleep";
			pinctrl-0 = <0xffffffff>;
			pinctrl-1 = <0xffffffff>;
			status = "ok";
		};
	};

	fragment@10 {
		target = <0xffffffff>;

		__overlay__ {
			vdd-supply = <0xffffffff>;
			qcom,vdd-voltage-level = <0x2d2a80 0x2d2a80>;
			qcom,vdd-current-level = <0x00 0xc3500>;
			vdd-io-supply = <0xffffffff>;
			qcom,vdd-io-voltage-level = <0x1b7740 0x2d2a80>;
			qcom,vdd-io-current-level = <0x00 0x55f0>;
			vdd-io-bias-supply = <0xffffffff>;
			qcom,vdd-io-bias-voltage-level = <0x132a40 0x132a40>;
			qcom,vdd-io-bias-current-level = <0x00 0x1770>;
			pinctrl-names = "default", "sleep";
			pinctrl-0 = <0xffffffff>;
			pinctrl-1 = <0xffffffff>;
			cd-gpios = <0xffffffff 0x58 0x01>;
			status = "ok";
		};
	};

	fragment@11 {
		target = <0xffffffff>;

		__overlay__ {
			compatible = "qcom,ufs-phy-qmp-v4-khaje";
			vdda-phy-supply = <0xffffffff>;
			vdda-pll-supply = <0xffffffff>;
			vdda-phy-max-microamp = <0x14ec4>;
			vdda-pll-max-microamp = <0x477c>;
			status = "ok";
		};
	};

	fragment@12 {
		target = <0xffffffff>;

		__overlay__ {
			vdd-hba-supply = <0xffffffff>;
			vdd-hba-fixed-regulator;
			vcc-supply = <0xffffffff>;
			vcc-max-microamp = "", "\f5";
			vccq2-supply = <0xffffffff>;
			vccq2-max-microamp = "", "\f5";
			qcom,vddp-ref-clk-supply = <0xffffffff>;
			qcom,vddp-ref-clk-max-microamp = <0x64>;
			reset-gpios = <0xffffffff 0x71 0x01>;
			resets = <0xffffffff 0x04>;
			reset-names = "rst";
			status = "ok";
		};
	};

	fragment@13 {
		target = <0xffffffff>;

		__overlay__ {
			status = "ok";
		};
	};

	fragment@14 {
		target = <0xffffffff>;

		__overlay__ {
			status = "ok";
			clock-frequency = <0x61a80>;
			#address-cells = <0x01>;
			#size-cells = <0x00>;

			sn-i2c@28 {
				status = "ok";
				compatible = "nxp,sn-nci";
				reg = <0x28>;
				nxp,sn-irq = <0xffffffff 0x46 0x00>;
				nxp,sn-ven-rstn = <0xffffffff 0x02 0x00>;
				interrupt-parent = <0xffffffff>;
				interrupts = <0x46 0x00>;
				interrupt-names = "nfc_irq";
				pinctrl-names = "nfc_active", "nfc_suspend";
				pinctrl-0 = <0xffffffff 0xffffffff>;
				pinctrl-1 = <0xffffffff 0xffffffff>;
			};
		};
	};

	fragment@15 {
		target = <0xffffffff>;

		__overlay__ {

			synaptics_tcm@20 {
				status = "disabled";
			};

			novatek@62 {
				status = "disabled";
			};
		};
	};

	fragment@16 {
		target = <0xffffffff>;

		__overlay__ {

			dwc3@4e00000 {
				dr_mode = "otg";
			};
		};
	};

	__symbols__ {
		led_flash_rear_aux2 = "/fragment@23/__overlay__/qcom,camera-flash@2";
		led_flash_rear_aux = "/fragment@23/__overlay__/qcom,camera-flash@1";
		led_flash_rear = "/fragment@23/__overlay__/qcom,camera-flash@0";
		eeprom_rear_aux2 = "/fragment@23/__overlay__/qcom,eeprom3";
		eeprom_front = "/fragment@23/__overlay__/qcom,eeprom2";
		eeprom_rear_aux = "/fragment@23/__overlay__/qcom,eeprom1";
		eeprom_rear = "/fragment@23/__overlay__/qcom,eeprom0";
		actuator_rear_aux = "/fragment@23/__overlay__/qcom,actuator1";
		actuator_rear = "/fragment@23/__overlay__/qcom,actuator0";
		cam_res_mgr_label = "/fragment@22/__overlay__/qcom,cam-res-mgr";
		clock_audio_va_2 = "/fragment@20/__overlay__/va_npl_clk";
		clock_audio_va_1 = "/fragment@20/__overlay__/va_core_clk";
		clock_audio_tx_2 = "/fragment@20/__overlay__/tx_npl_clk";
		clock_audio_tx_1 = "/fragment@20/__overlay__/tx_core_clk";
		clock_audio_rx_2 = "/fragment@20/__overlay__/rx_npl_clk";
		clock_audio_rx_1 = "/fragment@20/__overlay__/rx_core_clk";
		wsa881x_analog_clk = "/fragment@20/__overlay__/wsa_ana_clk";
		wsa881x_analog_reset_gpio = "/fragment@20/__overlay__/msm_cdc_pinctrl@106";
		wcd937x_rst_gpio = "/fragment@20/__overlay__/msm_cdc_pinctrl@92";
		wsa881x_i2c_44 = "/fragment@19/__overlay__/wsa881x-i2c-codec@44";
		wsa881x_i2c_e = "/fragment@19/__overlay__/wsa881x-i2c-codec@e";
		cdc_sec_mi2s_gpios = "/fragment@18/__overlay__/sec_mi2s_pinctrl";
		cdc_pri_mi2s_gpios = "/fragment@18/__overlay__/pri_mi2s_pinctrl";
		bengal_snd = "/fragment@18/__overlay__/sound";
		wcd937x_codec = "/fragment@17/__overlay__/wcd937x-codec";
		wcd937x_tx_slave = "/fragment@17/__overlay__/va-macro@a730000/va_swr_master/wcd937x-tx-slave";
		swr0 = "/fragment@17/__overlay__/va-macro@a730000/va_swr_master";
		va_macro = "/fragment@17/__overlay__/va-macro@a730000";
		wcd937x_rx_slave = "/fragment@17/__overlay__/rx-macro@a600000/rx_swr_master/wcd937x-rx-slave";
		swr1 = "/fragment@17/__overlay__/rx-macro@a600000/rx_swr_master";
		rx_macro = "/fragment@17/__overlay__/rx-macro@a600000";
		tx_macro = "/fragment@17/__overlay__/tx-macro@a620000";
		rf_pa1_therm_default = "/fragment@5/__overlay__/rf_pa1_therm/rf_pa1_therm_default";
		vib_out_gpio8_default = "/fragment@5/__overlay__/vib_out_gpio8/vib_out_gpio8_default";
		key_vol_up_default = "/fragment@5/__overlay__/key_vol_up/key_vol_up_default";
		usb_eldo9 = "/fragment@5/__overlay__/eldo9_pin/gpio@c000";
		vdda_usb_ss_dp_core = "/fragment@6/__overlay__/vdda_usb_ss_dp_core";
	};

	__fixups__ {
		cam_sensor_csi_mux_sel_suspend = "/fragment@23/__overlay__/qcom,cam-sensor2:pinctrl-1:12", "/fragment@23/__overlay__/qcom,cam-sensor3:pinctrl-1:12";
		cam_sensor_csi_mux_oe_suspend = "/fragment@23/__overlay__/qcom,cam-sensor2:pinctrl-1:8", "/fragment@23/__overlay__/qcom,cam-sensor3:pinctrl-1:8";
		cam_sensor_csi_mux_sel_active = "/fragment@23/__overlay__/qcom,cam-sensor2:pinctrl-0:12", "/fragment@23/__overlay__/qcom,cam-sensor3:pinctrl-0:12";
		cam_sensor_csi_mux_oe_active = "/fragment@23/__overlay__/qcom,cam-sensor2:pinctrl-0:8", "/fragment@23/__overlay__/qcom,cam-sensor3:pinctrl-0:8";
		cam_sensor_rear2_reset_suspend = "/fragment@23/__overlay__/qcom,eeprom3:pinctrl-1:4", "/fragment@23/__overlay__/qcom,cam-sensor3:pinctrl-1:4";
		cam_sensor_mclk3_suspend = "/fragment@23/__overlay__/qcom,eeprom3:pinctrl-1:0", "/fragment@23/__overlay__/qcom,cam-sensor3:pinctrl-1:0";
		cam_sensor_rear2_reset_active = "/fragment@23/__overlay__/qcom,eeprom3:pinctrl-0:4", "/fragment@23/__overlay__/qcom,cam-sensor3:pinctrl-0:4";
		cam_sensor_mclk3_active = "/fragment@23/__overlay__/qcom,eeprom3:pinctrl-0:0", "/fragment@23/__overlay__/qcom,cam-sensor3:pinctrl-0:0";
		cam_sensor_front0_reset_suspend = "/fragment@23/__overlay__/qcom,eeprom2:pinctrl-1:4", "/fragment@23/__overlay__/qcom,cam-sensor2:pinctrl-1:4";
		cam_sensor_mclk2_suspend = "/fragment@23/__overlay__/qcom,eeprom2:pinctrl-1:0", "/fragment@23/__overlay__/qcom,cam-sensor2:pinctrl-1:0";
		cam_sensor_front0_reset_active = "/fragment@23/__overlay__/qcom,eeprom2:pinctrl-0:4", "/fragment@23/__overlay__/qcom,cam-sensor2:pinctrl-0:4";
		cam_sensor_mclk2_active = "/fragment@23/__overlay__/qcom,eeprom2:pinctrl-0:0", "/fragment@23/__overlay__/qcom,cam-sensor2:pinctrl-0:0";
		L6P = "/fragment@23/__overlay__/qcom,eeprom2:cam_vana-supply:0", "/fragment@23/__overlay__/qcom,eeprom3:cam_vana-supply:0", "/fragment@23/__overlay__/qcom,cam-sensor2:cam_vana-supply:0", "/fragment@23/__overlay__/qcom,cam-sensor3:cam_vana-supply:0";
		cam_sensor_rear1_reset_suspend = "/fragment@23/__overlay__/qcom,eeprom1:pinctrl-1:4", "/fragment@23/__overlay__/qcom,cam-sensor1:pinctrl-1:4";
		cam_sensor_mclk1_suspend = "/fragment@23/__overlay__/qcom,eeprom1:pinctrl-1:0", "/fragment@23/__overlay__/qcom,cam-sensor1:pinctrl-1:0";
		cam_sensor_rear1_reset_active = "/fragment@23/__overlay__/qcom,eeprom1:pinctrl-0:4", "/fragment@23/__overlay__/qcom,cam-sensor1:pinctrl-0:4";
		cam_sensor_mclk1_active = "/fragment@23/__overlay__/qcom,eeprom1:pinctrl-0:0", "/fragment@23/__overlay__/qcom,cam-sensor1:pinctrl-0:0";
		L1P = "/fragment@23/__overlay__/qcom,eeprom1:cam_vdig-supply:0", "/fragment@23/__overlay__/qcom,eeprom3:cam_vdig-supply:0", "/fragment@23/__overlay__/qcom,cam-sensor1:cam_vdig-supply:0", "/fragment@23/__overlay__/qcom,cam-sensor3:cam_vdig-supply:0";
		L3P = "/fragment@23/__overlay__/qcom,eeprom1:cam_vana-supply:0", "/fragment@23/__overlay__/qcom,cam-sensor1:cam_vana-supply:0";
		cam_sensor_rear0_reset_suspend = "/fragment@23/__overlay__/qcom,eeprom0:pinctrl-1:4", "/fragment@23/__overlay__/qcom,cam-sensor0:pinctrl-1:4";
		cam_sensor_mclk0_suspend = "/fragment@23/__overlay__/qcom,eeprom0:pinctrl-1:0", "/fragment@23/__overlay__/qcom,cam-sensor0:pinctrl-1:0";
		cam_sensor_rear0_reset_active = "/fragment@23/__overlay__/qcom,eeprom0:pinctrl-0:4", "/fragment@23/__overlay__/qcom,cam-sensor0:pinctrl-0:4";
		cam_sensor_mclk0_active = "/fragment@23/__overlay__/qcom,eeprom0:pinctrl-0:0", "/fragment@23/__overlay__/qcom,cam-sensor0:pinctrl-0:0";
		gcc_camss_top_gdsc = "/fragment@23/__overlay__/qcom,eeprom0:cam_clk-supply:0", "/fragment@23/__overlay__/qcom,eeprom1:cam_clk-supply:0", "/fragment@23/__overlay__/qcom,eeprom2:cam_clk-supply:0", "/fragment@23/__overlay__/qcom,eeprom3:cam_clk-supply:0", "/fragment@23/__overlay__/qcom,cam-sensor0:cam_clk-supply:0", "/fragment@23/__overlay__/qcom,cam-sensor1:cam_clk-supply:0", "/fragment@23/__overlay__/qcom,cam-sensor2:cam_clk-supply:0", "/fragment@23/__overlay__/qcom,cam-sensor3:cam_clk-supply:0";
		L2P = "/fragment@23/__overlay__/qcom,eeprom0:cam_vdig-supply:0", "/fragment@23/__overlay__/qcom,eeprom2:cam_vdig-supply:0", "/fragment@23/__overlay__/qcom,cam-sensor0:cam_vdig-supply:0", "/fragment@23/__overlay__/qcom,cam-sensor2:cam_vdig-supply:0";
		L4P = "/fragment@23/__overlay__/qcom,eeprom0:cam_vana-supply:0", "/fragment@23/__overlay__/qcom,cam-sensor0:cam_vana-supply:0";
		L7P = "/fragment@23/__overlay__/qcom,eeprom0:cam_vio-supply:0", "/fragment@23/__overlay__/qcom,eeprom1:cam_vio-supply:0", "/fragment@23/__overlay__/qcom,eeprom2:cam_vio-supply:0", "/fragment@23/__overlay__/qcom,eeprom3:cam_vio-supply:0", "/fragment@23/__overlay__/qcom,camera-flash@0:cam_vio-supply:0", "/fragment@23/__overlay__/qcom,camera-flash@1:cam_vio-supply:0", "/fragment@23/__overlay__/qcom,camera-flash@2:cam_vio-supply:0", "/fragment@23/__overlay__/qcom,cam-sensor0:cam_vio-supply:0", "/fragment@23/__overlay__/qcom,cam-sensor1:cam_vio-supply:0", "/fragment@23/__overlay__/qcom,cam-sensor2:cam_vio-supply:0", "/fragment@23/__overlay__/qcom,cam-sensor3:cam_vio-supply:0";
		L5P = "/fragment@23/__overlay__/qcom,actuator0:cam_vaf-supply:0", "/fragment@23/__overlay__/qcom,actuator1:cam_vaf-supply:0", "/fragment@23/__overlay__/qcom,eeprom0:cam_vaf-supply:0", "/fragment@23/__overlay__/qcom,eeprom1:cam_vaf-supply:0";
		cam_cci0 = "/fragment@23:target:0", "/fragment@24:target:0";
		adsp_loader = "/fragment@21:target:0";
		spkr_1_sd_n_sleep = "/fragment@20/__overlay__/msm_cdc_pinctrl@106:pinctrl-1:0";
		spkr_1_sd_n_active = "/fragment@20/__overlay__/msm_cdc_pinctrl@106:pinctrl-0:0";
		wcd937x_reset_sleep = "/fragment@20/__overlay__/msm_cdc_pinctrl@92:pinctrl-1:0";
		wcd937x_reset_active = "/fragment@20/__overlay__/msm_cdc_pinctrl@92:pinctrl-0:0";
		wsa881x_analog_clk_gpio = "/fragment@19/__overlay__/wsa881x-i2c-codec@e:qcom,wsa-analog-clk-gpio:0";
		lpi_i2s2_sd1_sleep = "/fragment@18/__overlay__/sec_mi2s_pinctrl:pinctrl-1:12";
		lpi_i2s2_sd0_sleep = "/fragment@18/__overlay__/sec_mi2s_pinctrl:pinctrl-1:8";
		lpi_i2s2_ws_sleep = "/fragment@18/__overlay__/sec_mi2s_pinctrl:pinctrl-1:4";
		lpi_i2s2_sck_sleep = "/fragment@18/__overlay__/sec_mi2s_pinctrl:pinctrl-1:0";
		lpi_i2s2_sd1_active = "/fragment@18/__overlay__/sec_mi2s_pinctrl:pinctrl-0:12";
		lpi_i2s2_sd0_active = "/fragment@18/__overlay__/sec_mi2s_pinctrl:pinctrl-0:8";
		lpi_i2s2_ws_active = "/fragment@18/__overlay__/sec_mi2s_pinctrl:pinctrl-0:4";
		lpi_i2s2_sck_active = "/fragment@18/__overlay__/sec_mi2s_pinctrl:pinctrl-0:0";
		lpi_i2s1_sd1_sleep = "/fragment@18/__overlay__/pri_mi2s_pinctrl:pinctrl-1:12";
		lpi_i2s1_sd0_sleep = "/fragment@18/__overlay__/pri_mi2s_pinctrl:pinctrl-1:8";
		lpi_i2s1_ws_sleep = "/fragment@18/__overlay__/pri_mi2s_pinctrl:pinctrl-1:4";
		lpi_i2s1_sck_sleep = "/fragment@18/__overlay__/pri_mi2s_pinctrl:pinctrl-1:0";
		lpi_i2s1_sd1_active = "/fragment@18/__overlay__/pri_mi2s_pinctrl:pinctrl-0:12";
		lpi_i2s1_sd0_active = "/fragment@18/__overlay__/pri_mi2s_pinctrl:pinctrl-0:8";
		lpi_i2s1_ws_active = "/fragment@18/__overlay__/pri_mi2s_pinctrl:pinctrl-0:4";
		lpi_i2s1_sck_active = "/fragment@18/__overlay__/pri_mi2s_pinctrl:pinctrl-0:0";
		lpi_tlmm = "/fragment@18/__overlay__/sound:qcom,msm_audio_ssr_devs:4";
		audio_gpr = "/fragment@18/__overlay__/sound:qcom,msm_audio_ssr_devs:0";
		stub_codec = "/fragment@18/__overlay__/sound:asoc-codec:0";
		adsp_variant = "/fragment@18/__overlay__/sound:nvmem-cells:0", "/fragment@21/__overlay__:nvmem-cells:0";
		cdc_dmic23_gpios = "/fragment@18/__overlay__/sound:qcom,cdc-dmic23-gpios:0";
		cdc_dmic01_gpios = "/fragment@18/__overlay__/sound:qcom,cdc-dmic01-gpios:0";
		spf_core_platform = "/fragment@18:target:0";
		L14A = "/fragment@17/__overlay__/wcd937x-codec:cdc-vdd-buck-supply:0";
		L9A = "/fragment@17/__overlay__/wcd937x-codec:cdc-vdd-rxtx-supply:0", "/fragment@17/__overlay__/wcd937x-codec:cdc-vddpx-supply:0";
		va_swr_gpios = "/fragment@17/__overlay__/va-macro@a730000:qcom,va-swr-gpios:0";
		lpass_audio_hw_vote = "/fragment@17/__overlay__/rx-macro@a600000/rx_swr_master:clocks:0", "/fragment@17/__overlay__/va-macro@a730000:clocks:0", "/fragment@17/__overlay__/va-macro@a730000/va_swr_master:clocks:0";
		rx_swr_gpios = "/fragment@17/__overlay__/rx-macro@a600000:qcom,rx-swr-gpios:0";
		bolero_cdc = "/fragment@17:target:0", "/fragment@18/__overlay__/sound:asoc-codec:4", "/fragment@18/__overlay__/sound:qcom,msm_audio_ssr_devs:8";
		thermal_zones = "/fragment@0:target:0", "/fragment@4:target:0";
		pm6125_trip0 = "/fragment@0/__overlay__/pm6125-tz/cooling-maps/trip0_cpu0:trip:0", "/fragment@0/__overlay__/pm6125-tz/cooling-maps/trip0_cpu1:trip:0", "/fragment@0/__overlay__/pm6125-tz/cooling-maps/trip0_cpu2:trip:0", "/fragment@0/__overlay__/pm6125-tz/cooling-maps/trip0_cpu3:trip:0", "/fragment@0/__overlay__/pm6125-tz/cooling-maps/trip0_cpu4:trip:0", "/fragment@0/__overlay__/pm6125-tz/cooling-maps/trip0_cpu5:trip:0", "/fragment@0/__overlay__/pm6125-tz/cooling-maps/trip0_cpu6:trip:0", "/fragment@0/__overlay__/pm6125-tz/cooling-maps/trip0_cpu7:trip:0";
		CPU0 = "/fragment@0/__overlay__/pm6125-tz/cooling-maps/trip0_cpu0:cooling-device:0";
		CPU1 = "/fragment@0/__overlay__/pm6125-tz/cooling-maps/trip0_cpu1:cooling-device:0";
		CPU2 = "/fragment@0/__overlay__/pm6125-tz/cooling-maps/trip0_cpu2:cooling-device:0";
		CPU3 = "/fragment@0/__overlay__/pm6125-tz/cooling-maps/trip0_cpu3:cooling-device:0";
		CPU4 = "/fragment@0/__overlay__/pm6125-tz/cooling-maps/trip0_cpu4:cooling-device:0";
		CPU5 = "/fragment@0/__overlay__/pm6125-tz/cooling-maps/trip0_cpu5:cooling-device:0";
		CPU6 = "/fragment@0/__overlay__/pm6125-tz/cooling-maps/trip0_cpu6:cooling-device:0";
		CPU7 = "/fragment@0/__overlay__/pm6125-tz/cooling-maps/trip0_cpu7:cooling-device:0";
		pm6125_trip1 = "/fragment@0/__overlay__/pm6125-tz/cooling-maps/trip1_cpu1:trip:0", "/fragment@0/__overlay__/pm6125-tz/cooling-maps/trip1_cpu2:trip:0", "/fragment@0/__overlay__/pm6125-tz/cooling-maps/trip1_cpu3:trip:0", "/fragment@0/__overlay__/pm6125-tz/cooling-maps/trip1_cpu4:trip:0", "/fragment@0/__overlay__/pm6125-tz/cooling-maps/trip1_cpu5:trip:0", "/fragment@0/__overlay__/pm6125-tz/cooling-maps/trip1_cpu6:trip:0", "/fragment@0/__overlay__/pm6125-tz/cooling-maps/trip1_cpu7:trip:0";
		cpu1_pause = "/fragment@0/__overlay__/pm6125-tz/cooling-maps/trip1_cpu1:cooling-device:0";
		cpu2_pause = "/fragment@0/__overlay__/pm6125-tz/cooling-maps/trip1_cpu2:cooling-device:0";
		cpu3_pause = "/fragment@0/__overlay__/pm6125-tz/cooling-maps/trip1_cpu3:cooling-device:0";
		cpu4_pause = "/fragment@0/__overlay__/pm6125-tz/cooling-maps/trip1_cpu4:cooling-device:0";
		cpu5_pause = "/fragment@0/__overlay__/pm6125-tz/cooling-maps/trip1_cpu5:cooling-device:0";
		cpu6_pause = "/fragment@0/__overlay__/pm6125-tz/cooling-maps/trip1_cpu6:cooling-device:0";
		cpu7_pause = "/fragment@0/__overlay__/pm6125-tz/cooling-maps/trip1_cpu7:cooling-device:0";
		qupv3_se4_2uart = "/fragment@1:target:0";
		pm6125_vadc = "/fragment@2:target:0", "/fragment@3/__overlay__/rf_pa1_therm:io-channels:0";
		camera_therm_default = "/fragment@2/__overlay__:pinctrl-0:0";
		emmc_therm_default = "/fragment@2/__overlay__:pinctrl-0:4";
		pm6125_adc_tm = "/fragment@3:target:0", "/fragment@4/__overlay__/rf-pa1-therm-usr:thermal-sensors:0";
		pm6125_gpios = "/fragment@5:target:0", "/fragment@6/__overlay__/gpio_keys/vol_up:gpios:0", "/fragment@6/__overlay__/vibrator_gpio:vib,en-gpio:0", "/fragment@6/__overlay__/vdda_usb_ss_dp_core:gpio:0";
		soc = "/fragment@6:target:0", "/fragment@20:target:0", "/fragment@22:target:0";
		usb_qmp_dp_phy = "/fragment@7:target:0";
		qupv3_se1_i2c = "/fragment@8:target:0", "/fragment@19:target:0";
		sdhc_1 = "/fragment@9:target:0";
		L24A = "/fragment@9/__overlay__:vdd-supply:0", "/fragment@12/__overlay__:vcc-supply:0";
		L11A = "/fragment@9/__overlay__:vdd-io-supply:0", "/fragment@12/__overlay__:vccq2-supply:0";
		sdc1_on = "/fragment@9/__overlay__:pinctrl-0:0";
		sdc1_off = "/fragment@9/__overlay__:pinctrl-1:0";
		sdhc_2 = "/fragment@10:target:0";
		L22A = "/fragment@10/__overlay__:vdd-supply:0";
		L5A = "/fragment@10/__overlay__:vdd-io-supply:0";
		L7A = "/fragment@10/__overlay__:vdd-io-bias-supply:0";
		sdc2_on = "/fragment@10/__overlay__:pinctrl-0:0";
		sdc2_off = "/fragment@10/__overlay__:pinctrl-1:0";
		tlmm = "/fragment@10/__overlay__:cd-gpios:0", "/fragment@12/__overlay__:reset-gpios:0", "/fragment@14/__overlay__/sn-i2c@28:nxp,sn-irq:0", "/fragment@14/__overlay__/sn-i2c@28:nxp,sn-ven-rstn:0", "/fragment@14/__overlay__/sn-i2c@28:interrupt-parent:0", "/fragment@23/__overlay__/qcom,eeprom0:gpios:0", "/fragment@23/__overlay__/qcom,eeprom0:gpios:12", "/fragment@23/__overlay__/qcom,eeprom1:gpios:0", "/fragment@23/__overlay__/qcom,eeprom1:gpios:12", "/fragment@23/__overlay__/qcom,eeprom2:gpios:0", "/fragment@23/__overlay__/qcom,eeprom2:gpios:12", "/fragment@23/__overlay__/qcom,eeprom3:gpios:0", "/fragment@23/__overlay__/qcom,eeprom3:gpios:12", "/fragment@23/__overlay__/qcom,cam-sensor0:gpios:0", "/fragment@23/__overlay__/qcom,cam-sensor0:gpios:12", "/fragment@23/__overlay__/qcom,cam-sensor1:gpios:0", "/fragment@23/__overlay__/qcom,cam-sensor1:gpios:12", "/fragment@23/__overlay__/qcom,cam-sensor2:gpios:0", "/fragment@23/__overlay__/qcom,cam-sensor2:gpios:12", "/fragment@23/__overlay__/qcom,cam-sensor2:gpios:24", "/fragment@23/__overlay__/qcom,cam-sensor2:gpios:36", "/fragment@23/__overlay__/qcom,cam-sensor3:gpios:0", "/fragment@23/__overlay__/qcom,cam-sensor3:gpios:12", "/fragment@23/__overlay__/qcom,cam-sensor3:gpios:24", "/fragment@23/__overlay__/qcom,cam-sensor3:gpios:36";
		ufsphy_mem = "/fragment@11:target:0";
		L4A = "/fragment@11/__overlay__:vdda-phy-supply:0";
		L18A = "/fragment@11/__overlay__:vdda-pll-supply:0", "/fragment@12/__overlay__:qcom,vddp-ref-clk-supply:0";
		ufshc_mem = "/fragment@12:target:0";
		gcc_ufs_phy_gdsc = "/fragment@12/__overlay__:vdd-hba-supply:0";
		gcc = "/fragment@12/__overlay__:resets:0", "/fragment@23/__overlay__/qcom,eeprom0:clocks:0", "/fragment@23/__overlay__/qcom,eeprom1:clocks:0", "/fragment@23/__overlay__/qcom,eeprom2:clocks:0", "/fragment@23/__overlay__/qcom,eeprom3:clocks:0", "/fragment@23/__overlay__/qcom,cam-sensor0:clocks:0", "/fragment@23/__overlay__/qcom,cam-sensor1:clocks:0", "/fragment@23/__overlay__/qcom,cam-sensor2:clocks:0", "/fragment@23/__overlay__/qcom,cam-sensor3:clocks:0";
		pm6125_pwm = "/fragment@13:target:0";
		qupv3_se0_i2c = "/fragment@14:target:0";
		nfc_int_active = "/fragment@14/__overlay__/sn-i2c@28:pinctrl-0:0";
		nfc_enable_active = "/fragment@14/__overlay__/sn-i2c@28:pinctrl-0:4";
		nfc_int_suspend = "/fragment@14/__overlay__/sn-i2c@28:pinctrl-1:0";
		nfc_enable_suspend = "/fragment@14/__overlay__/sn-i2c@28:pinctrl-1:4";
		qupv3_se2_i2c = "/fragment@15:target:0";
		usb0 = "/fragment@16:target:0";
	};

	__local_fixups__ {

		fragment@2 {

			__overlay__ {
				pinctrl-0 = <0x08>;
			};
		};

		fragment@6 {

			__overlay__ {

				gpio_keys {
					pinctrl-0 = <0x00>;
				};

				vibrator_gpio {
					pinctrl-0 = <0x00>;
				};

				vdda_usb_ss_dp_core {
					pinctrl-0 = <0x00>;
				};
			};
		};

		fragment@7 {

			__overlay__ {
				vdd-supply = <0x00>;
			};
		};

		fragment@17 {

			__overlay__ {

				bolero-clk-rsc-mngr {
					clocks = <0x00 0x08 0x10 0x18 0x20 0x28>;
				};

				tx-macro@a620000 {
					clocks = <0x00 0x08>;
				};

				rx-macro@a600000 {
					clocks = <0x00 0x08>;
				};

				wcd937x-codec {
					qcom,tx-slave = <0x00>;
					qcom,rx-slave = <0x00>;
					qcom,wcd-rst-gpio-node = <0x00>;
				};
			};
		};

		fragment@18 {

			__overlay__ {

				sound {
					asoc-codec = <0x08 0x0c>;
				};
			};
		};

		fragment@19 {

			__overlay__ {

				wsa881x-i2c-codec@e {
					qcom,wsa-analog-reset-gpio = <0x00>;
					clocks = <0x00>;
				};
			};
		};

		fragment@23 {

			__overlay__ {

				qcom,cam-sensor0 {
					eeprom-src = <0x00>;
					led-flash-src = <0x00>;
					actuator-src = <0x00>;
				};

				qcom,cam-sensor1 {
					eeprom-src = <0x00>;
					led-flash-src = <0x00>;
					actuator-src = <0x00>;
				};

				qcom,cam-sensor2 {
					eeprom-src = <0x00>;
				};

				qcom,cam-sensor3 {
					eeprom-src = <0x00>;
					led-flash-src = <0x00>;
				};
			};
		};
	};

	fragment@17 {
		target = <0xffffffff>;

		__overlay__ {
			qcom,bolero-version = <0x05>;
			qcom,num-macros = <0x03>;

			bolero-clk-rsc-mngr {
				clocks = <0x06 0x00 0x07 0x00 0x08 0x00 0x09 0x00 0x0a 0x00 0x0b 0x00>;
				clock-names = "tx_core_clk", "tx_npl_clk", "rx_core_clk", "rx_npl_clk", "va_core_clk", "va_npl_clk";
				qcom,va_mclk_mode_muxsel = "\nz", "";
				qcom,rx_mclk_mode_muxsel = <0xa5640d8>;
				qcom,fs-gen-sequence = <0x3000 0x01 0x01 0x3004 0x03 0x03 0x3004 0x03 0x01 0x3080 0x02 0x02>;
				compatible = "qcom,bolero-clk-rsc-mngr";
			};

			tx-macro@a620000 {
				phandle = <0x13>;
				qcom,is-used-swr-gpio = <0x00>;
				qcom,tx-dmic-sample-rate = <0x249f00>;
				clocks = <0x06 0x00 0x07 0x00>;
				clock-names = "tx_core_clk", "tx_npl_clk";
				reg = <0xa620000 0x00>;
				compatible = "qcom,tx-macro";
			};

			rx-macro@a600000 {
				phandle = <0x14>;
				qcom,default-clk-id = <0x00>;
				qcom,rx-bcl-pmic-params = [00 04 3e];
				qcom,rx_mclk_mode_muxsel = <0xa5640d8>;
				qcom,rx-swr-gpios = <0xffffffff>;
				clocks = <0x08 0x00 0x09 0x00>;
				clock-names = "rx_core_clk", "rx_npl_clk";
				reg = <0xa600000 0x00>;
				compatible = "qcom,rx-macro";

				rx_swr_master {
					phandle = <0x15>;
					qcom,swr-clock-stop-mode0 = <0x01>;
					qcom,disable-div2-clk-switch = <0x01>;
					qcom,swr-num-dev = <0x01>;
					qcom,swr-port-mapping = <0x01 0x0e 0x01 0x01 0x0f 0x02 0x02 0x12 0x01 0x03 0x10 0x01 0x03 0x11 0x02 0x04 0x13 0x01 0x05 0x14 0x01 0x05 0x15 0x02>;
					qcom,swr-num-ports = <0x05>;
					interrupt-names = "swr_master_irq";
					interrupts = <0x00 0x129 0x04>;
					swrm-io-base = <0xa610000 0x00>;
					qcom,mipi-sdw-block-packing-mode = <0x01>;
					qcom,swrm-hctl-reg = <0xa6a9098>;
					qcom,swr_master_id = <0x02>;
					qcom,swr-master-version = <0x1060000>;
					clocks = <0xffffffff 0x00>;
					clock-names = "lpass_audio_hw_vote";
					#size-cells = <0x00>;
					#address-cells = <0x02>;
					compatible = "qcom,swr-mstr";

					wcd937x-rx-slave {
						phandle = <0x0d>;
						reg = <0x0a 0x1170224>;
						compatible = "qcom,wcd937x-slave";
					};
				};
			};

			va-macro@a730000 {
				phandle = <0x16>;
				qcom,va-swr-gpios = <0xffffffff>;
				qcom,is-used-swr-gpio = <0x01>;
				qcom,default-clk-id = <0x00>;
				qcom,va-island-mode-muxsel = "\nz", "";
				qcom,va-clk-mux-select = <0x01>;
				qcom,va-dmic-sample-rate = <0x927c0>;
				clocks = <0xffffffff 0x00>;
				clock-names = "lpass_audio_hw_vote";
				reg = <0xa730000 0x00>;
				compatible = "qcom,va-macro";

				va_swr_master {
					phandle = <0x17>;
					qcom,is-always-on = <0x01>;
					qcom,swr-mstr-irq-wakeup-capable = <0x01>;
					qcom,swr-clock-stop-mode0 = <0x01>;
					qcom,swr-num-dev = <0x01>;
					qcom,swr-port-mapping = <0x01 0x2e 0x01 0x01 0x2f 0x02 0x01 0x30 0x04 0x01 0x31 0x08 0x02 0x32 0x01 0x02 0x33 0x02 0x02 0x34 0x04 0x02 0x35 0x08 0x03 0x36 0x01 0x03 0x37 0x02 0x03 0x38 0x04 0x03 0x39 0x08>;
					qcom,swr-num-ports = <0x03>;
					qcom,swr-wakeup-required = <0x01>;
					interrupt-names = "swr_master_irq", "swr_wake_irq";
					interrupts = <0x00 0x128 0x04 0x00 0x4f 0x04>;
					swrm-io-base = <0xa740000 0x00>;
					qcom,mipi-sdw-block-packing-mode = <0x01>;
					qcom,swrm-hctl-reg = <0xa7ec100>;
					qcom,swr_master_id = <0x03>;
					qcom,swr-master-version = <0x1060000>;
					clocks = <0xffffffff 0x00>;
					clock-names = "lpass_audio_hw_vote";
					#size-cells = <0x00>;
					#address-cells = <0x02>;
					compatible = "qcom,swr-mstr";

					wcd937x-tx-slave {
						phandle = <0x0e>;
						reg = <0x0a 0x1170223>;
						compatible = "qcom,wcd937x-slave";
					};
				};
			};

			wcd937x-codec {
				phandle = <0x0f>;
				qcom,cdc-on-demand-supplies = "cdc-vdd-buck";
				qcom,cdc-static-supplies = "cdc-vdd-rxtx", "cdc-vddpx";
				qcom,cdc-micbias3-mv = <0x708>;
				qcom,cdc-micbias2-mv = <0x708>;
				qcom,cdc-micbias1-mv = <0x708>;
				qcom,cdc-vdd-buck-current = <0x9eb10>;
				qcom,cdc-vdd-buck-voltage = <0x1b7740 0x1b7740>;
				cdc-vdd-buck-supply = <0xffffffff>;
				qcom,cdc-vddpx-current = <0x4e20>;
				qcom,cdc-vddpx-voltage = <0x1b7740 0x1b7740>;
				cdc-vddpx-supply = <0xffffffff>;
				qcom,cdc-vdd-rxtx-current = <0x2710>;
				qcom,cdc-vdd-rxtx-voltage = <0x1b7740 0x1b7740>;
				cdc-vdd-rxtx-supply = <0xffffffff>;
				qcom,tx-slave = <0x0e>;
				qcom,rx-slave = <0x0d>;
				qcom,wcd-rst-gpio-node = <0x0c>;
				qcom,swr-tx-port-params = <0x01 0x00 0x00 0x01 0x01 0x00 0x01 0x00 0x00 0x01 0x01 0x00 0x01 0x00 0x01 0x00 0x00 0x01 0x02 0x00 0x01 0x00 0x02 0x00 0x01 0x00 0x01 0x00 0x01 0x00 0x01 0x00>;
				qcom,tx_swr_ch_map = <0x00 0x1e 0x01 0x493e00 0x2e 0x01 0x1f 0x01 0x493e00 0x32 0x01 0x20 0x02 0x493e00 0x33 0x02 0x22 0x01 0x00 0x31 0x02 0x23 0x02 0x00 0x32 0x02 0x1d 0x04 0x493e00 0x33 0x03 0x24 0x01 0x00 0x34 0x03 0x25 0x02 0x00 0x35 0x03 0x26 0x04 0x00 0x36 0x03 0x27 0x08 0x00 0x37>;
				qcom,rx_swr_ch_map = <0x00 0x0e 0x01 0x00 0x0e 0x00 0x0f 0x02 0x00 0x0f 0x01 0x12 0x01 0x00 0x12 0x02 0x10 0x01 0x00 0x10 0x02 0x11 0x02 0x00 0x11 0x03 0x13 0x01 0x00 0x13 0x04 0x14 0x01 0x00 0x14 0x04 0x15 0x02 0x00 0x15>;
				qcom,split-codec = <0x01>;
				compatible = "qcom,wcd937x-codec";
			};
		};
	};

	fragment@18 {
		target = <0xffffffff>;

		__overlay__ {

			sound {
				phandle = <0x18>;
				qcom,msm_audio_ssr_devs = <0xffffffff 0xffffffff 0xffffffff>;
				qcom,wsa-aux-dev-prefix = "SpkrMono";
				qcom,wsa-max-devs = <0x01>;
				asoc-codec-names = "msm-stub-codec.1", "bolero-codec", "wcd937x_codec", "wsa-codec0";
				asoc-codec = <0xffffffff 0xffffffff 0x0f 0x10>;
				nvmem-cell-names = "adsp_variant";
				nvmem-cells = <0xffffffff>;
				qcom,cdc-dmic23-gpios = <0xffffffff>;
				qcom,cdc-dmic01-gpios = <0xffffffff>;
				qcom,msm-mbhc-gnd-swh = <0x01>;
				qcom,msm-mbhc-hphl-swh = <0x01>;
				qcom,msm-mbhc-usbc-audio-supported = <0x00>;
				qcom,audio-routing = "AMIC1", "Analog Mic1", "AMIC1", "MIC BIAS1", "AMIC2", "Analog Mic2", "AMIC2", "MIC BIAS2", "AMIC3", "Analog Mic3", "AMIC3", "MIC BIAS3", "TX DMIC0", "Digital Mic0", "TX DMIC0", "MIC BIAS1", "TX DMIC1", "Digital Mic1", "TX DMIC1", "MIC BIAS1", "TX DMIC2", "Digital Mic2", "TX DMIC2", "MIC BIAS3", "TX DMIC3", "Digital Mic3", "TX DMIC3", "MIC BIAS3", "IN1_HPHL", "HPHL_OUT", "IN2_HPHR", "HPHR_OUT", "IN3_AUX", "AUX_OUT", "RX_TX DEC0_INP", "TX DEC0 MUX", "RX_TX DEC1_INP", "TX DEC1 MUX", "RX_TX DEC2_INP", "TX DEC2 MUX", "RX_TX DEC3_INP", "TX DEC3 MUX", "SpkrMono WSA_IN", "AUX", "TX SWR_INPUT", "WCD_TX_OUTPUT", "VA SWR_INPUT", "VA_SWR_CLK", "VA SWR_INPUT", "WCD_TX_OUTPUT", "TX_AIF1 CAP", "VA_SWR_CLK", "TX_AIF2 CAP", "VA_SWR_CLK", "TX_AIF3 CAP", "VA_SWR_CLK", "VA DMIC0", "Digital Mic0", "VA DMIC1", "Digital Mic1", "VA DMIC2", "Digital Mic2", "VA DMIC3", "Digital Mic3", "VA DMIC0", "VA MIC BIAS1", "VA DMIC1", "VA MIC BIAS1", "VA DMIC2", "VA MIC BIAS3", "VA DMIC3", "VA MIC BIAS3";
				qcom,rxtx-bolero-codec = <0x01>;
				qcom,va-bolero-codec = <0x01>;
				qcom,wcn-btfm = <0x01>;
				qcom,msm-mi2s-master = <0x01 0x01 0x01 0x01>;
				qcom,model = "bengal-idp-snd-card";
			};

			pri_mi2s_pinctrl {
				phandle = <0x19>;
				#gpio-cells = <0x00>;
				qcom,lpi-gpios;
				pinctrl-1 = <0xffffffff 0xffffffff 0xffffffff 0xffffffff>;
				pinctrl-0 = <0xffffffff 0xffffffff 0xffffffff 0xffffffff>;
				pinctrl-names = "aud_active", "aud_sleep";
				compatible = "qcom,msm-cdc-pinctrl";
			};

			sec_mi2s_pinctrl {
				phandle = <0x1a>;
				#gpio-cells = <0x00>;
				qcom,lpi-gpios;
				pinctrl-1 = <0xffffffff 0xffffffff 0xffffffff 0xffffffff>;
				pinctrl-0 = <0xffffffff 0xffffffff 0xffffffff 0xffffffff>;
				pinctrl-names = "aud_active", "aud_sleep";
				compatible = "qcom,msm-cdc-pinctrl";
			};
		};
	};

	fragment@19 {
		target = <0xffffffff>;

		__overlay__ {

			wsa881x-i2c-codec@e {
				phandle = <0x10>;
				qcom,wsa-prefix = "SpkrMono";
				qcom,wsa-analog-reset-gpio = <0x12>;
				qcom,wsa-analog-clk-gpio = <0xffffffff>;
				clocks = <0x11 0x00>;
				clock-names = "wsa_mclk";
				reg = <0x0e>;
				compatible = "qcom,wsa881x-i2c-codec";
			};

			wsa881x-i2c-codec@44 {
				phandle = <0x1b>;
				reg = <0x44>;
				compatible = "qcom,wsa881x-i2c-codec";
			};
		};
	};

	fragment@20 {
		target = <0xffffffff>;

		__overlay__ {

			msm_cdc_pinctrl@92 {
				phandle = <0x0c>;
				#gpio-cells = <0x00>;
				pinctrl-1 = <0xffffffff>;
				pinctrl-0 = <0xffffffff>;
				pinctrl-names = "aud_active", "aud_sleep";
				compatible = "qcom,msm-cdc-pinctrl";
			};

			msm_cdc_pinctrl@106 {
				phandle = <0x12>;
				#gpio-cells = <0x00>;
				pinctrl-1 = <0xffffffff>;
				pinctrl-0 = <0xffffffff>;
				pinctrl-names = "aud_active", "aud_sleep";
				compatible = "qcom,msm-cdc-pinctrl";
			};

			wsa_ana_clk {
				phandle = <0x11>;
				#clock-cells = <0x01>;
				qcom,codec-lpass-clk-id = <0x301>;
				qcom,codec-lpass-ext-clk-freq = <0x927c00>;
				qcom,codec-ext-clk-src = <0x03>;
				compatible = "qcom,audio-ref-clk";
			};

			rx_core_clk {
				phandle = <0x08>;
				#clock-cells = <0x01>;
				qcom,codec-lpass-clk-id = <0x30e>;
				qcom,codec-lpass-ext-clk-freq = <0x1588800>;
				qcom,codec-ext-clk-src = <0x05>;
				compatible = "qcom,audio-ref-clk";
			};

			rx_npl_clk {
				phandle = <0x09>;
				#clock-cells = <0x01>;
				qcom,codec-lpass-clk-id = <0x30f>;
				qcom,codec-lpass-ext-clk-freq = <0x1588800>;
				qcom,codec-ext-clk-src = <0x06>;
				compatible = "qcom,audio-ref-clk";
			};

			tx_core_clk {
				phandle = <0x06>;
				#clock-cells = <0x01>;
				qcom,codec-lpass-clk-id = <0x30c>;
				qcom,codec-lpass-ext-clk-freq = <0x124f800>;
				qcom,codec-ext-clk-src = <0x07>;
				compatible = "qcom,audio-ref-clk";
			};

			tx_npl_clk {
				phandle = <0x07>;
				#clock-cells = <0x01>;
				qcom,codec-lpass-clk-id = <0x30d>;
				qcom,codec-lpass-ext-clk-freq = <0x124f800>;
				qcom,codec-ext-clk-src = <0x08>;
				compatible = "qcom,audio-ref-clk";
			};

			va_core_clk {
				phandle = <0x0a>;
				#clock-cells = <0x01>;
				qcom,codec-lpass-clk-id = <0x307>;
				qcom,codec-lpass-ext-clk-freq = <0x124f800>;
				qcom,codec-ext-clk-src = <0x02>;
				compatible = "qcom,audio-ref-clk";
			};

			va_npl_clk {
				phandle = <0x0b>;
				#clock-cells = <0x01>;
				qcom,codec-lpass-clk-id = <0x308>;
				qcom,codec-lpass-ext-clk-freq = <0x124f800>;
				qcom,codec-ext-clk-src = <0x0a>;
				compatible = "qcom,audio-ref-clk";
			};
		};
	};

	fragment@21 {
		target = <0xffffffff>;

		__overlay__ {
			adsp-fw-bit-values = <0x01>;
			adsp-fw-names = "adsp2";
			nvmem-cell-names = "adsp_variant";
			nvmem-cells = <0xffffffff>;
		};
	};

	fragment@22 {
		target = <0xffffffff>;

		__overlay__ {

			qcom,cam-res-mgr {
				phandle = <0x25>;
				status = "ok";
				compatible = "qcom,cam-res-mgr";
			};
		};
	};

	fragment@23 {
		target = <0xffffffff>;

		__overlay__ {

			qcom,actuator0 {
				phandle = <0x1c>;
				status = "ok";
				rgltr-load-current = <0x186a0>;
				rgltr-max-voltage = <0x2ab980>;
				rgltr-min-voltage = <0x2ab980>;
				rgltr-cntrl-support;
				regulator-names = "cam_vaf";
				cam_vaf-supply = <0xffffffff>;
				cci-master = <0x00>;
				compatible = "qcom,actuator";
				cell-index = <0x00>;
			};

			qcom,actuator1 {
				phandle = <0x1f>;
				status = "ok";
				rgltr-load-current = <0x186a0>;
				rgltr-max-voltage = <0x2ab980>;
				rgltr-min-voltage = <0x2ab980>;
				rgltr-cntrl-support;
				regulator-names = "cam_vaf";
				cam_vaf-supply = <0xffffffff>;
				cci-master = <0x01>;
				compatible = "qcom,actuator";
				cell-index = <0x01>;
			};

			qcom,eeprom0 {
				phandle = <0x1e>;
				clock-rates = <0x124f800>;
				clock-cntl-level = "turbo";
				clock-names = "cam_clk";
				clocks = <0xffffffff 0x18>;
				status = "ok";
				cci-master = <0x00>;
				sensor-mode = <0x00>;
				gpio-req-tbl-label = "CAMIF_MCLK0", "CAM_RESET0";
				gpio-req-tbl-flags = <0x01 0x00>;
				gpio-req-tbl-num = <0x00 0x01>;
				gpio-reset = <0x01>;
				gpios = <0xffffffff 0x14 0x00 0xffffffff 0x12 0x00>;
				pinctrl-1 = <0xffffffff 0xffffffff>;
				pinctrl-0 = <0xffffffff 0xffffffff>;
				pinctrl-names = "cam_default", "cam_suspend";
				gpio-no-mux = <0x00>;
				rgltr-load-current = <0x1d4c0 0x13880 0x124f80 0x00 0x186a0>;
				rgltr-max-voltage = <0x1b7740 0x2ab980 0x101d00 0x00 0x2ab980>;
				rgltr-min-voltage = <0x1b7740 0x2ab980 0x101d00 0x00 0x2ab980>;
				pwm-switch;
				rgltr-cntrl-support;
				regulator-names = "cam_vio", "cam_vana", "cam_vdig", "cam_clk", "cam_vaf";
				cam_clk-supply = <0xffffffff>;
				cam_vaf-supply = <0xffffffff>;
				cam_vdig-supply = <0xffffffff>;
				cam_vana-supply = <0xffffffff>;
				cam_vio-supply = <0xffffffff>;
				compatible = "qcom,eeprom";
				cell-index = <0x00>;
			};

			qcom,eeprom1 {
				phandle = <0x21>;
				clock-rates = <0x124f800>;
				clock-cntl-level = "turbo";
				clock-names = "cam_clk";
				clocks = <0xffffffff 0x1a>;
				status = "ok";
				cci-master = <0x01>;
				sensor-mode = <0x00>;
				gpio-req-tbl-label = "CAMIF_MCLK1", "CAM_RESET1";
				gpio-req-tbl-flags = <0x01 0x00>;
				gpio-req-tbl-num = <0x00 0x01>;
				gpio-reset = <0x01>;
				gpios = <0xffffffff 0x15 0x00 0xffffffff 0x13 0x00>;
				pinctrl-1 = <0xffffffff 0xffffffff>;
				pinctrl-0 = <0xffffffff 0xffffffff>;
				pinctrl-names = "cam_default", "cam_suspend";
				gpio-no-mux = <0x00>;
				rgltr-load-current = <0x1d4c0 0x13880 0x124f80 0x00 0x186a0>;
				rgltr-max-voltage = <0x1b7740 0x2ab980 0x124f80 0x00 0x2ab980>;
				rgltr-min-voltage = <0x1b7740 0x2ab980 0x124f80 0x00 0x2ab980>;
				pwm-switch;
				rgltr-cntrl-support;
				regulator-names = "cam_vio", "cam_vana", "cam_vdig", "cam_clk", "cam_vaf";
				cam_clk-supply = <0xffffffff>;
				cam_vaf-supply = <0xffffffff>;
				cam_vdig-supply = <0xffffffff>;
				cam_vana-supply = <0xffffffff>;
				cam_vio-supply = <0xffffffff>;
				compatible = "qcom,eeprom";
				cell-index = <0x01>;
			};

			qcom,eeprom2 {
				phandle = <0x22>;
				clock-rates = <0x16e3600>;
				clock-cntl-level = "turbo";
				clock-names = "cam_clk";
				clocks = <0xffffffff 0x1c>;
				status = "ok";
				cci-master = <0x01>;
				sensor-mode = <0x00>;
				gpio-req-tbl-label = "CAMIF_MCLK2", "CAM_RESET2";
				gpio-req-tbl-flags = <0x01 0x00>;
				gpio-req-tbl-num = <0x00 0x01>;
				gpio-reset = <0x01>;
				gpios = <0xffffffff 0x1b 0x00 0xffffffff 0x18 0x00>;
				pinctrl-1 = <0xffffffff 0xffffffff>;
				pinctrl-0 = <0xffffffff 0xffffffff>;
				pinctrl-names = "cam_default", "cam_suspend";
				gpio-no-mux = <0x00>;
				rgltr-load-current = <0x00 0x13880 0x19a28 0x00>;
				rgltr-max-voltage = <0x1b7740 0x2ab980 0x101d00 0x00>;
				rgltr-min-voltage = <0x1b7740 0x2ab980 0x101d00 0x00>;
				pwm-switch;
				rgltr-cntrl-support;
				regulator-names = "cam_vio", "cam_vana", "cam_vdig", "cam_clk";
				cam_clk-supply = <0xffffffff>;
				cam_vdig-supply = <0xffffffff>;
				cam_vana-supply = <0xffffffff>;
				cam_vio-supply = <0xffffffff>;
				compatible = "qcom,eeprom";
				cell-index = <0x02>;
			};

			qcom,eeprom3 {
				phandle = <0x24>;
				clock-rates = <0x124f800>;
				clock-cntl-level = "turbo";
				clock-names = "cam_clk";
				clocks = <0xffffffff 0x1e>;
				status = "ok";
				cci-master = <0x00>;
				sensor-mode = <0x00>;
				gpio-req-tbl-label = "CAMIF_MCLK3", "CAM_RESET3";
				gpio-req-tbl-flags = <0x01 0x00>;
				gpio-req-tbl-num = <0x00 0x01>;
				gpio-reset = <0x01>;
				gpios = <0xffffffff 0x1c 0x00 0xffffffff 0x41 0x00>;
				pinctrl-1 = <0xffffffff 0xffffffff>;
				pinctrl-0 = <0xffffffff 0xffffffff>;
				pinctrl-names = "cam_default", "cam_suspend";
				gpio-no-mux = <0x00>;
				rgltr-load-current = <0x1d4c0 0x13880 0x124f80 0x00>;
				rgltr-max-voltage = <0x1b7740 0x2ab980 0x124f80 0x00>;
				rgltr-min-voltage = <0x1b7740 0x2ab980 0x124f80 0x00>;
				pwm-switch;
				rgltr-cntrl-support;
				regulator-names = "cam_vio", "cam_vana", "cam_vdig", "cam_clk";
				cam_clk-supply = <0xffffffff>;
				cam_vdig-supply = <0xffffffff>;
				cam_vana-supply = <0xffffffff>;
				cam_vio-supply = <0xffffffff>;
				compatible = "qcom,eeprom";
				cell-index = <0x03>;
			};

			qcom,camera-flash@0 {
				phandle = <0x1d>;
				status = "ok";
				gpio-req-tbl-label = "CUSTOM_GPIO1";
				gpio-req-tbl-flags = <0x00>;
				gpio-req-tbl-num = <0x00>;
				gpio-custom1 = <0x00>;
				gpio-no-mux = <0x00>;
				rgltr-load-current = <0x1d4c0>;
				rgltr-max-voltage = <0x1b7740>;
				rgltr-min-voltage = <0x1b7740>;
				rgltr-cntrl-support;
				regulator-names = "cam_vio";
				cam_vio-supply = <0xffffffff>;
				flash-type = <0x01>;
				cci-master = <0x01>;
				compatible = "qcom,camera-flash";
				cell-index = <0x00>;
			};

			qcom,camera-flash@1 {
				phandle = <0x20>;
				status = "ok";
				gpio-req-tbl-label = "CUSTOM_GPIO1";
				gpio-req-tbl-flags = <0x00>;
				gpio-req-tbl-num = <0x00>;
				gpio-custom1 = <0x00>;
				gpio-no-mux = <0x00>;
				rgltr-load-current = <0x1d4c0>;
				rgltr-max-voltage = <0x1b7740>;
				rgltr-min-voltage = <0x1b7740>;
				rgltr-cntrl-support;
				regulator-names = "cam_vio";
				cam_vio-supply = <0xffffffff>;
				flash-type = <0x01>;
				cci-master = <0x01>;
				compatible = "qcom,camera-flash";
				cell-index = <0x01>;
			};

			qcom,camera-flash@2 {
				phandle = <0x23>;
				status = "ok";
				gpio-req-tbl-label = "CUSTOM_GPIO1";
				gpio-req-tbl-flags = <0x00>;
				gpio-req-tbl-num = <0x00>;
				gpio-custom1 = <0x00>;
				gpio-no-mux = <0x00>;
				rgltr-load-current = <0x1d4c0>;
				rgltr-max-voltage = <0x1b7740>;
				rgltr-min-voltage = <0x1b7740>;
				rgltr-cntrl-support;
				regulator-names = "cam_vio";
				cam_vio-supply = <0xffffffff>;
				flash-type = <0x01>;
				cci-master = <0x01>;
				compatible = "qcom,camera-flash";
				cell-index = <0x02>;
			};

			qcom,cam-sensor0 {
				clock-rates = <0x124f800>;
				clock-cntl-level = "turbo";
				clock-names = "cam_clk";
				clocks = <0xffffffff 0x18>;
				status = "ok";
				cci-master = <0x00>;
				sensor-mode = <0x00>;
				gpio-req-tbl-label = "CAMIF_MCLK0", "CAM_RESET0";
				gpio-req-tbl-flags = <0x01 0x00>;
				gpio-req-tbl-num = <0x00 0x01>;
				gpio-reset = <0x01>;
				gpios = <0xffffffff 0x14 0x00 0xffffffff 0x12 0x00>;
				pinctrl-1 = <0xffffffff 0xffffffff>;
				pinctrl-0 = <0xffffffff 0xffffffff>;
				pinctrl-names = "cam_default", "cam_suspend";
				gpio-no-mux = <0x00>;
				rgltr-load-current = <0x1d4c0 0x13880 0x124f80 0x00>;
				rgltr-max-voltage = <0x1b7740 0x2ab980 0x101d00 0x00>;
				rgltr-min-voltage = <0x1b7740 0x2ab980 0x101d00 0x00>;
				pwm-switch;
				rgltr-cntrl-support;
				regulator-names = "cam_vio", "cam_vana", "cam_vdig", "cam_clk";
				cam_clk-supply = <0xffffffff>;
				cam_vdig-supply = <0xffffffff>;
				cam_vana-supply = <0xffffffff>;
				cam_vio-supply = <0xffffffff>;
				eeprom-src = <0x1e>;
				led-flash-src = <0x1d>;
				actuator-src = <0x1c>;
				sensor-position-yaw = <0xb4>;
				sensor-position-pitch = <0x00>;
				sensor-position-roll = <0x10e>;
				csiphy-sd-index = <0x00>;
				compatible = "qcom,cam-sensor";
				cell-index = <0x00>;
			};

			qcom,cam-sensor1 {
				clock-rates = <0x124f800>;
				clock-cntl-level = "turbo";
				clock-names = "cam_clk";
				clocks = <0xffffffff 0x1a>;
				status = "ok";
				cci-master = <0x01>;
				sensor-mode = <0x00>;
				gpio-req-tbl-label = "CAMIF_MCLK1", "CAM_RESET1";
				gpio-req-tbl-flags = <0x01 0x00>;
				gpio-req-tbl-num = <0x00 0x01>;
				gpio-reset = <0x01>;
				gpios = <0xffffffff 0x15 0x00 0xffffffff 0x13 0x00>;
				pinctrl-1 = <0xffffffff 0xffffffff>;
				pinctrl-0 = <0xffffffff 0xffffffff>;
				pinctrl-names = "cam_default", "cam_suspend";
				gpio-no-mux = <0x00>;
				rgltr-load-current = <0x1d4c0 0x13880 0x124f80 0x00>;
				rgltr-max-voltage = <0x1b7740 0x2ab980 0x124f80 0x00>;
				rgltr-min-voltage = <0x1b7740 0x2ab980 0x124f80 0x00>;
				pwm-switch;
				rgltr-cntrl-support;
				regulator-names = "cam_vio", "cam_vana", "cam_vdig", "cam_clk";
				cam_clk-supply = <0xffffffff>;
				cam_vdig-supply = <0xffffffff>;
				cam_vana-supply = <0xffffffff>;
				cam_vio-supply = <0xffffffff>;
				eeprom-src = <0x21>;
				led-flash-src = <0x20>;
				actuator-src = <0x1f>;
				sensor-position-yaw = <0xb4>;
				sensor-position-pitch = <0x00>;
				sensor-position-roll = <0x10e>;
				csiphy-sd-index = <0x01>;
				compatible = "qcom,cam-sensor";
				cell-index = <0x01>;
			};

			qcom,cam-sensor2 {
				clock-rates = <0x16e3600>;
				clock-cntl-level = "turbo";
				clock-names = "cam_clk";
				clocks = <0xffffffff 0x1c>;
				status = "ok";
				cci-master = <0x01>;
				sensor-mode = <0x00>;
				gpio-req-tbl-label = "CAMIF_MCLK2", "CAM_RESET2", "CAM_CSIMUX_OE0", "CAM_CSIMUX_SEL0";
				gpio-req-tbl-flags = <0x01 0x00>;
				gpio-req-tbl-num = <0x00 0x01>;
				gpio-custom2 = <0x03>;
				gpio-custom1 = <0x02>;
				gpio-reset = <0x01>;
				gpios = <0xffffffff 0x1b 0x00 0xffffffff 0x18 0x00 0xffffffff 0x42 0x00 0xffffffff 0x43 0x00>;
				pinctrl-1 = <0xffffffff 0xffffffff 0xffffffff 0xffffffff>;
				pinctrl-0 = <0xffffffff 0xffffffff 0xffffffff 0xffffffff>;
				pinctrl-names = "cam_default", "cam_suspend";
				gpio-no-mux = <0x00>;
				rgltr-load-current = <0x00 0x13880 0x19a28 0x00>;
				rgltr-max-voltage = <0x1b7740 0x2ab980 0x101d00 0x00>;
				rgltr-min-voltage = <0x1b7740 0x2ab980 0x101d00 0x00>;
				pwm-switch;
				rgltr-cntrl-support;
				regulator-names = "cam_vio", "cam_vana", "cam_vdig", "cam_clk";
				cam_clk-supply = <0xffffffff>;
				cam_vdig-supply = <0xffffffff>;
				cam_vana-supply = <0xffffffff>;
				cam_vio-supply = <0xffffffff>;
				eeprom-src = <0x22>;
				sensor-position-yaw = <0x00>;
				sensor-position-pitch = <0x00>;
				sensor-position-roll = <0x10e>;
				csiphy-sd-index = <0x02>;
				compatible = "qcom,cam-sensor";
				cell-index = <0x02>;
			};

			qcom,cam-sensor3 {
				clock-rates = <0x124f800>;
				clock-cntl-level = "turbo";
				clock-names = "cam_clk";
				clocks = <0xffffffff 0x1e>;
				status = "ok";
				cci-master = <0x00>;
				sensor-mode = <0x00>;
				gpio-req-tbl-label = "CAMIF_MCLK3", "CAM_RESET3", "CAM_CSIMUX_OE1", "CAM_CSIMUX_SEL1";
				gpio-req-tbl-flags = <0x01 0x00>;
				gpio-req-tbl-num = <0x00 0x01>;
				gpio-custom2 = <0x03>;
				gpio-custom1 = <0x02>;
				gpio-reset = <0x01>;
				gpios = <0xffffffff 0x1c 0x00 0xffffffff 0x41 0x00 0xffffffff 0x42 0x00 0xffffffff 0x43 0x00>;
				pinctrl-1 = <0xffffffff 0xffffffff 0xffffffff 0xffffffff>;
				pinctrl-0 = <0xffffffff 0xffffffff 0xffffffff 0xffffffff>;
				pinctrl-names = "cam_default", "cam_suspend";
				gpio-no-mux = <0x00>;
				rgltr-load-current = <0x1d4c0 0x13880 0x124f80 0x00>;
				rgltr-max-voltage = <0x1b7740 0x2ab980 0x124f80 0x00>;
				rgltr-min-voltage = <0x1b7740 0x2ab980 0x124f80 0x00>;
				pwm-switch;
				rgltr-cntrl-support;
				regulator-names = "cam_vio", "cam_vana", "cam_vdig", "cam_clk";
				cam_clk-supply = <0xffffffff>;
				cam_vdig-supply = <0xffffffff>;
				cam_vana-supply = <0xffffffff>;
				cam_vio-supply = <0xffffffff>;
				eeprom-src = <0x24>;
				led-flash-src = <0x23>;
				sensor-position-yaw = <0xb4>;
				sensor-position-pitch = <0x00>;
				sensor-position-roll = <0x10e>;
				csiphy-sd-index = <0x02>;
				compatible = "qcom,cam-sensor";
				cell-index = <0x03>;
			};
		};
	};

	fragment@24 {
		target = <0xffffffff>;

		__overlay__ {

			qcom,camera-flash@0 {
				status = "disabled";
			};

			qcom,camera-flash@1 {
				status = "disabled";
			};

			qcom,camera-flash@2 {
				status = "disabled";
			};
		};
	};
};
